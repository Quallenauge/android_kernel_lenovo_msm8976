## arch/arm64/configs/YTX703_specific_defconfig
```kconfig
# This config contains all additional properties which
# are device and project specific

CONFIG_LOCALVERSION="_LA.BR.1.3.7_rb1.11"

CONFIG_LOG_BUF_SHIFT=20

# CONFIG_TOUCHSCREEN_SYNAPTICS_DSX_RMI_DEV_v21 is not set
# CONFIG_TOUCHSCREEN_SYNAPTICS_DSX_FW_UPDATE_v21 is not set
# CONFIG_TOUCHSCREEN_ATMEL_MXT is not set
# CONFIG_TOUCHSCREEN_FT5X06 is not set
# CONFIG_TOUCHSCREEN_GEN_VKEYS is not set
# CONFIG_TOUCHSCREEN_SYNAPTICS_I2C_RMI4 is not set
# CONFIG_TOUCHSCREEN_BU21150 is not set

# CONFIG_SND_PCI is not set
# CONFIG_AUDIO_OCMEM is not set

# CONFIG_HID_APPLE is not set
# CONFIG_HID_ELECOM is not set
# CONFIG_HID_MAGICMOUSE is not set
# CONFIG_HID_MICROSOFT is not set

# CONFIG_USB_MON is not set
# CONFIG_USB_ICE40_HCD is not set
# CONFIG_USB_CCID_BRIDGE is not set
# CONFIG_USB_STORAGE_DATAFAB is not set
# CONFIG_USB_STORAGE_FREECOM is not set
# CONFIG_USB_STORAGE_ISD200 is not set
# CONFIG_USB_STORAGE_USBAT is not set
# CONFIG_USB_STORAGE_SDDR09 is not set
# CONFIG_USB_STORAGE_SDDR55 is not set
# CONFIG_USB_STORAGE_JUMPSHOT is not set
# CONFIG_USB_STORAGE_ALAUDA is not set

# CONFIG_USB_STORAGE_KARMA is not set
# CONFIG_USB_STORAGE_CYPRESS_ATACB is not set
# CONFIG_USB_SERIAL is not set

# CONFIG_DM_VERITY is not set

# CONFIG_USB_EXT_TYPE_C_PERICOM is not set

CONFIG_USB_RTL8152=y
CONFIG_USB_USBNET=y
CONFIG_USB_NET_AX8817X=y
CONFIG_USB_NET_AX88179_178A=y

# CONFIG_INPUT_MOUSEDEV_PSAUX is not set
# CONFIG_INPUT_EVBUG is not set
# CONFIG_KEYBOARD_ATKBD is not set
# CONFIG_INPUT_MT_WRAPPER is not set
# CONFIG_INPUT_HBTP_INPUT is not set

CONFIG_INPUT_GPIO=y

# CONFIG_SENSORS_MMC3416X is not set
# CONFIG_SENSORS_AKM09911 is not set
# CONFIG_SENSORS_AKM8963 is not set
# CONFIG_SENSORS_CAPELLA_CM36283 is not set
# CONFIG_SENSORS_BMA2X2 is not set
# CONFIG_SENSORS_MC3430 is not set
# CONFIG_SENSORS_ISL29044A is not set
# CONFIG_SENSORS_MPU6050 is not set
# CONFIG_SENSORS_LIS3DH is not set

# CONFIG_RMNET_DATA_DEBUG_PKT is not set

CONFIG_ZRAM_LZ4_COMPRESS=y

CONFIG_BATTERY_BQ27541=y
CONFIG_BATTERY_BQ27541_I2C=y
CONFIG_BATTERY_BQ27541_PLATFORM=y
CONFIG_CHARGER_BQ25892=y

# CONFIG_SMB1351_USB_CHARGER is not set
# CONFIG_SMB135X_CHARGER is not set
# CONFIG_SMB1360_CHARGER_FG is not set
# CONFIG_QPNP_FG is not set
# CONFIG_REGULATOR_FAN53555 is not set
# CONFIG_REGULATOR_ONSEMI_NCP6335D is not set
# CONFIG_REGULATOR_TPS65132 is not set

# CONFIG_MEDIA_RADIO_SUPPORT is not set

# CONFIG_USB_GSPCA is not set

CONFIG_SPI_SPIDEV=y

CONFIG_BACKLIGHT_LCD_SUPPORT=y
CONFIG_BACKLIGHT_CLASS_DEVICE=y
CONFIG_BACKLIGHT_GENERIC=y
CONFIG_BACKLIGHT_LP855X=y

CONFIG_FUSB_30X=y
CONFIG_LEDS_AW2013=y

CONFIG_PRONTO_WLAN=y
# CONFIG_PRIMA_WLAN_BTAMP is not set
CONFIG_PRIMA_WLAN_LFR=y
CONFIG_PRIMA_WLAN_OKC=y
CONFIG_PRIMA_WLAN_11AC_HIGH_TP=y
CONFIG_WLAN_FEATURE_11W=y
CONFIG_QCOM_TDLS=y
CONFIG_QCOM_VOWIFI_11R=y
CONFIG_ENABLE_LINUX_REG=y
CONFIG_WLAN_OFFLOAD_PACKETS=y

CONFIG_PSTORE=y
CONFIG_PSTORE_CONSOLE=y
CONFIG_PSTORE_PMSG=y
CONFIG_PSTORE_RAM=y

CONFIG_F2FS_FS=y
CONFIG_F2FS_STAT_FS=y
# CONFIG_F2FS_FS_XATTR is not set
# CONFIG_NETWORK_FILESYSTEMS is not set

CONFIG_DYNAMIC_DEBUG=y

# CONFIG_MSM_PERFORMANCE_HOTPLUG_ON is not set
CONFIG_MSM_OCMEM=y
CONFIG_MSM_OCMEM_LOCAL_POWER_CTRL=y

# CONFIG_LEDS_QPNP is not set
# CONFIG_LEDS_QPNP_FLASH is not set
# CONFIG_LEDS_QPNP_WLED is not set
# CONFIG_LEDS_MSM_GPIO_FLASH is not set
# CONFIG_LEDS_TRIGGERS is not set

# CONFIG_EDAC is not set

CONFIG_CPU_FREQ_GOV_CONSERVATIVE=y
CONFIG_KSM=y

CONFIG_NLS_UTF8=y

CONFIG_ARM_ARCH_TIMER_VCT_ACCESS=y


CONFIG_TASKSTATS=y
CONFIG_TASK_IO_ACCOUNTING=y
CONFIG_TASK_XACCT=y
CONFIG_TASK_DELAY_ACCT=y

# CONFIG_IOMMU_AARCH64 is not set
```
