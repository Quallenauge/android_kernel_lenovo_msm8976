// SPDX-License-Identifier: GPL-2.0
/*
 * Copyright (c) 2015, The Linux Foundation. All rights reserved.
 */

#include "msm8976.dtsi"

/ {
	model = "Qualcomm Technologies, Inc. APQ 8076";
	compatible = "qcom,apq8076";
	qcom,msm-id = <277 0>;
};
